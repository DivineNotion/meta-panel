## conf/distro/brivo-panel.conf
```bitbake
# Distro Layer configuration
# include and overwrite default poky distro

require conf/distro/poky.conf

DISTRO = "brivo-panel"
DISTRO_NAME = "Brivo-Panels"
DISTRO_VERSION = "1.0"
DISTRO_CODENAME = "Kodiak"
SDK_VENDOR = "-panelsdk"
SDK_VERSION="${DISTRO_VERSION}"
MAINTAINER = "Robert Middleton <robert.middleton@brivo.com>, Abdullah Alawfi <abdullah.alawfi@brivo.com>, Eric Sandjong <eric.sandjong@brivo.com>"

DISTRO_FEATURES:remove ?= "opengl wayland vulkan x11 3g nfc pulseaudio"

DISTRO_FEATURES += "pam ppp"

# icu is needed to get egt
PACKAGECONFIG_DISTRO:pn-egt ?= "icu openssl freetype fontconfig"

EXTRA_OECONF:remove = "${DISABLE_STATIC}"
PREFERRED_VERSION_swig = "3.0.8"

VIRTUAL-RUNTIME_syslog = "busybox-syslog"

HOSTTOOLS:append = " xxd"

PACKAGECONFIG:remove:pn-rng-tools = "libjitterentropy"
```

## conf/layer.conf
```bitbake
# We have a conf and classes directory, add to BBPATH
BBPATH .= ":${LAYERDIR}"

# We have recipes-* directories, add to BBFILES
BBFILES += "${LAYERDIR}/recipes-*/*/*.bb \
            ${LAYERDIR}/recipes-*/*/*.bbappend"

BBFILE_COLLECTIONS += "meta-panel"
BBFILE_PATTERN_meta-panel = "^${LAYERDIR}/"
BBFILE_PRIORITY_meta-panel = "11"

LAYERDEPENDS_meta-panel = "core"
LAYERSERIES_COMPAT_meta-panel = "kirkstone"
```
